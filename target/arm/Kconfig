## target/arm/Kconfig
```kconfig
config ARM
    bool
    select ARM_COMPATIBLE_SEMIHOSTING if TCG

    # We need to select this until we move m_helper.c and the
    # translate.c v7m helpers under ARM_V7M.
    select ARM_V7M if TCG

config TARGET_ARM_M_BECO
    bool

config USER_TARGET_ICOUNT
    bool
    # When this flag is set, then the target icount is number fo instructions
    # executed, rather than host cpu cycles.
    depends on ARM

config AARCH64
    bool
    select ARM
```
